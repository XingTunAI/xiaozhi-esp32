## sdkconfig.defaults.voice-lab-waveshare
```kconfig
CONFIG_BOARD_TYPE_WAVESHARE_ESP32_S3_AUDIO_BOARD=y
CONFIG_AUDIO_BOARD_LCD_JD9853=y

CONFIG_VOICE_LAB_AUTO_CONNECT=y
CONFIG_VOICE_LAB_SERVER_HOST="voice-lab.cloud"
CONFIG_VOICE_LAB_SERVER_PORT=1883
CONFIG_VOICE_LAB_SERVER_TLS=y
CONFIG_VOICE_LAB_SERVER_URL=""
CONFIG_VOICE_LAB_DEVICE_KEY=""
CONFIG_VOICE_LAB_DEVICE_TOKEN=""
CONFIG_VOICE_LAB_HARDWARE_PROFILE="waveshare-esp32s3-audio-board"
CONFIG_VOICE_LAB_AUDIO_FRONTEND="waveshare-es7210"
CONFIG_VOICE_LAB_SUPPRESS_XIAOZHI_ACTIVATION=y
CONFIG_VOICE_LAB_STANDALONE_MODE=y
```
